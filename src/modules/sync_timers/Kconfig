## src/modules/sync_timers/Kconfig
```kconfig
menuconfig MODULES_SYNC_TIMERS
    bool "sync_timers"
    default n
    ---help---
        Module for measuring latency and clock offset between PX4 and Jetson.
```
